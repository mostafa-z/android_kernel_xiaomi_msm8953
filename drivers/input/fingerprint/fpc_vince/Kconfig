## drivers/input/fingerprint/fpc_vince/Kconfig
```kconfig
config FINGERPRINT_FPC1020_VINCE
	tristate "FingerPrint Cards vince fingerprint driver support"
	depends on INPUT_FINGERPRINT
	help
	  Say Y here to enable vince fpc fingerprint driver support!
```

## drivers/input/fingerprint/goodix_vince/Kconfig
```kconfig
config FINGERPRINT_GOODIX_GF3208_VINCE
	tristate "Goodix GF3208 vince fingerprint driver support"
	depends on INPUT_FINGERPRINT
	help
		Say Y here to enable goodix vince fingerprint driver support!
```
